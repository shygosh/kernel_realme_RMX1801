## drivers/input/misc/oppo_fp_drivers/Kconfig
```kconfig
menuconfig OPPO_FINGERPRINT
	bool "OPPO fingerprint"
	depends on SPI_MASTER
	help
	  Say Y here to enable OPPO fingerprint support

config OPPO_FINGERPRINT_QCOM
	bool "Fingerprint base on QCOM"
	depends on OPPO_FINGERPRINT
	default OPPO_FINGERPRINT
```

## drivers/power/supply/oppo/Kconfig
```kconfig
config OPPO_RTC_DET_SUPPORT
	bool "OPPO RTC DET SUPPORT"
	depends on OPPO_VENDOR_EDIT
	depends on MFD_SPMI_PMIC
	help
	  Say Y to include support

config OPPO_CHECK_CHARGERID_VOLT
	bool "OPPO CHECK CHARGERID VOLT"
	depends on OPPO_VENDOR_EDIT
	depends on MFD_SPMI_PMIC
	help
	  Say Y to include support

config OPPO_SHIP_MODE_SUPPORT
	bool "OPPO_SHIP_MODE_SUPPORT"
	depends on OPPO_VENDOR_EDIT
	depends on MFD_SPMI_PMIC
	help
	  Say Y to include support
```

## drivers/soc/oppo/Kconfig
```kconfig
source "drivers/soc/oppo/oppo_project/Kconfig"
source "drivers/soc/oppo/oppo_devinfo/Kconfig"
```

## drivers/soc/oppo/oppo_devinfo/Kconfig
```kconfig
config OPPO_DEVICE_INFO
	bool "config oppo devinfo"
	depends on OPPO_VENDOR_EDIT
	help
	  define this config to compile devinfo.c for device register.
```

## drivers/soc/oppo/oppo_project/Kconfig
```kconfig
config OPPO_COMMON_SOFT
	bool "config oppo common software"
	depends on OPPO_VENDOR_EDIT
	help
	  Define this config to get project verion from sharemem.
	  Maybe this value is from CDT or dynamic identify by hardware id.
```
